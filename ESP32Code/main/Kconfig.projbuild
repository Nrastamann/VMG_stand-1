## ESP32Code/main/Kconfig.projbuild
```kconfig
menu "Example Configuration"

    orsource "$IDF_PATH/examples/common_components/env_caps/$IDF_TARGET/Kconfig.env_caps"

    config GPIO_INPUT_0
        int "GPIO input pin 0"
        range ENV_GPIO_RANGE_MIN ENV_GPIO_IN_RANGE_MAX
        default 4
        help
            GPIO pin number to be used as GPIO_INPUT_IO_0.
    config EXAMPLE_TCP_CLIENT
        bool "TCP client"
        default y
        help
            This example will setup a tcp client, connects to the specified address
            and sends the data.

    if EXAMPLE_TCP_CLIENT
        config EXAMPLE_TCP_CLIENT_CONNECT_ADDRESS
            string "Client connection address or hostname"
            default "www.google.com"
            help
                Client's socket would connect to this address/host.

        config EXAMPLE_TCP_CLIENT_CONNECT_PORT
            string "Client connection port"
            default "80"
            help
                Client connection port.


endmenu
```
